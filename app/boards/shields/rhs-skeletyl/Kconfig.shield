## app/boards/shields/rhs-skeletyl/Kconfig.shield
```kconfig
# Copyright (c) 2020 Pete Johanson
# SPDX-License-Identifier: MIT

config SHIELD_RHS-SKELETYL_LEFT
	def_bool $(shields_list_contains,rhs-skeletyl_left)

config SHIELD_RHS-SKELETYL_RIGHT
	def_bool $(shields_list_contains,rhs-skeletyl_right)
```
